## config/boards/shields/wk_kinesis/Kconfig.defconfig
```kconfig
# Copyright (c) 2021 The ZMK Contributors
# SPDX-License-Identifier: MIT


if SHIELD_WK_KINESIS_LEFT

config ZMK_KEYBOARD_NAME
    default "WK 360 20260719"

config ZMK_SPLIT_ROLE_CENTRAL
    default y

endif


if SHIELD_WK_KINESIS_LEFT || SHIELD_WK_KINESIS_RIGHT

config ZMK_SPLIT
    default y

endif

config UART_0_INTERRUPT_DRIVEN
    depends on !ZMK_SPLIT_WIRED_UART_MODE_ASYNC
```
